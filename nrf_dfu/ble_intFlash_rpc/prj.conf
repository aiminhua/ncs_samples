## sample.yaml
```
sample:
  name: BLE DFU example
  description: the whole BLE stack runs on the network core. secondary slot on internal SoC flash
tests:
  samples.bluetooth.peripheral_uart:
    build_only: true
    build_on_all: true
    platform_allow: nrf51dk_nrf51422 nrf52dk_nrf52832 nrf52840dk_nrf52840
      nrf5340dk_nrf5340_cpuapp nrf5340dk_nrf5340_cpuappns
    tags: bluetooth ci_build
```

## prj.conf
```kconfig
#
# Copyright (c) 2018 Nordic Semiconductor
#
# SPDX-License-Identifier: LicenseRef-Nordic-5-Clause
#

CONFIG_GPIO=y

# Make sure printk is not printing to the UART console
CONFIG_CONSOLE=y
CONFIG_UART_CONSOLE=y

CONFIG_HEAP_MEM_POOL_SIZE=12288

CONFIG_FLASH=y
CONFIG_FLASH_PAGE_LAYOUT=y
CONFIG_FLASH_MAP=y
CONFIG_NVS=y
CONFIG_MPU_ALLOW_FLASH_WRITE=y
CONFIG_STREAM_FLASH=y
CONFIG_STREAM_FLASH_ERASE=y

# Enable DK LED and Buttons library
CONFIG_DK_LIBRARY=y

# This example requires more workqueue stack
CONFIG_SYSTEM_WORKQUEUE_STACK_SIZE=2048

# Config logger
CONFIG_LOG=y
CONFIG_LOG_PRINTK=y
CONFIG_LOG_BUFFER_SIZE=2048
# CONFIG_LOG_MODE_OVERFLOW=y
# CONFIG_LOG_BACKEND_FORMAT_TIMESTAMP=y
# CONFIG_USE_SEGGER_RTT=y
# CONFIG_LOG_BACKEND_RTT=y
# CONFIG_LOG_BACKEND_UART=y
# CONFIG_LOG_DEFAULT_LEVEL=4

CONFIG_ASSERT=y
# CONFIG_ASSERT_LEVEL=2

CONFIG_SERIAL=y
CONFIG_UART_ASYNC_API=y
CONFIG_UART_0_ASYNC=y
CONFIG_NRFX_UARTE0=y
CONFIG_UART_0_NRF_HW_ASYNC=y
CONFIG_UART_0_NRF_HW_ASYNC_TIMER=1

# Open the following config for NCS v1.6.x or earlier
# CONFIG_IPM=y
# CONFIG_IPM_NRFX=y
# CONFIG_IPM_MSG_CH_1_ENABLE=y
# CONFIG_IPM_MSG_CH_1_TX=y
# CONFIG_IPM_MSG_CH_0_ENABLE=y
# CONFIG_IPM_MSG_CH_0_RX=y
# CONFIG_OPENAMP=y
# CONFIG_NRF_RPC=y
# CONFIG_TINYCBOR=y
# CONFIG_RPMSG_MASTER=y
# CONFIG_THREAD_CUSTOM_DATA=y
# CONFIG_NRF_RPC_CBOR=y
# CONFIG_NRF_RPC_THREAD_STACK_SIZE=2048
# CONFIG_NRF_RPC_LOG_LEVEL_INF=y

# Open the following config for NCS v1.7.x or newer
CONFIG_TINYCBOR=y
CONFIG_RPMSG_SERVICE_MODE_MASTER=y
CONFIG_NRF_RPC=y
CONFIG_NRF_RPC_CBOR=y
CONFIG_NRF_RPC_THREAD_STACK_SIZE=4096
CONFIG_NRF_RPC_LOG_LEVEL_INF=y
CONFIG_NRF_RPC_TR_LOG_LEVEL_INF=y
CONFIG_NRF_RPC_OS_LOG_LEVEL_INF=y
# CONFIG_NRF_RPC_LOG_LEVEL_DBG=y
# CONFIG_NRF_RPC_TR_LOG_LEVEL_DBG=y
# CONFIG_NRF_RPC_OS_LOG_LEVEL_DBG=y
# CONFIG_RPMSG_SERVICE_LOG_LEVEL_DBG=y

CONFIG_NRF_DFU=y
CONFIG_NRF_DFU_RPC_APP=y
# CONFIG_NRF_DFU_LOG_LEVEL=3
CONFIG_BOOTLOADER_MCUBOOT=y
CONFIG_IMG_MANAGER=y
CONFIG_MCUBOOT_IMG_MANAGER=y
CONFIG_IMG_BLOCK_BUF_SIZE=4096

CONFIG_BLE_NETWORK_CORE=y
CONFIG_NRF53_UPGRADE_NETWORK_CORE=y
CONFIG_BOARD_ENABLE_CPUNET=y
```

## src/main.c
```c
/*
 * Copyright (c) 2018 Nordic Semiconductor ASA
 *
 * SPDX-License-Identifier: LicenseRef-Nordic-5-Clause
 */

/** @file
 *  @brief Nordic UART Bridge Service (NUS) sample
 */

#include <zephyr/types.h>
#include <zephyr.h>
#include <drivers/uart.h>

#include <device.h>
#include <soc.h>

#include <dk_buttons_and_leds.h>

#include <settings/settings.h>

#include <stdio.h>

#include "nrf_dfu_settings.h"
#include "nrf_dfu.h"

#include "uart_hs.h"
#include "sys/reboot.h"
#include "nrf_dfu.h"
#include "nrf_dfu_validation.h"
#include <drivers/nrfx_errors.h>
#include <logging/log.h>
#include <logging/log_ctrl.h>

#define LOG_MODULE_NAME main
LOG_MODULE_REGISTER(LOG_MODULE_NAME);

#define RUN_STATUS_LED DK_LED1
#define RUN_LED_BLINK_INTERVAL 1000


#define UART_BUF_SIZE CONFIG_BT_NUS_UART_BUFFER_SIZE
#define UART_WAIT_FOR_BUF_DELAY K_MSEC(50)
#define UART_WAIT_FOR_RX CONFIG_BT_NUS_UART_RX_WAIT_TIME

static void configure_gpio(void)
{
	int err;

	err = dk_leds_init();
	if (err) {
		LOG_ERR("Cannot init LEDs (err: %d)", err);
	}
}

/**@brief Function for handling DFU events.
 */
static void dfu_observer(nrf_dfu_evt_type_t evt_type)
{
    switch (evt_type)
    {
        case NRF_DFU_EVT_DFU_STARTED:
        case NRF_DFU_EVT_OBJECT_RECEIVED:

            break;
        case NRF_DFU_EVT_DFU_COMPLETED:
        case NRF_DFU_EVT_DFU_ABORTED:
			LOG_INF("resetting...");
			while(log_process(false));
            sys_reboot(SYS_REBOOT_WARM);
            break;
        case NRF_DFU_EVT_TRANSPORT_DEACTIVATED:
            // Reset the internal state of the DFU settings to the last stored state.
			LOG_INF("NRF_DFU_EVT_TRANSPORT_DEACTIVATED");
            nrf_dfu_settings_reinit();
            break;
        default:
            break;
    }

}

int dfu_init(void)
{
    int ret_val;

    ret_val = nrf_dfu_settings_init(true);
    if (ret_val != NRF_SUCCESS)
	{
		LOG_WRN("dfu settings init err %d", ret_val);
	}

    ret_val = nrf_dfu_init(dfu_observer);
    if (ret_val != NRF_SUCCESS)
	{
		LOG_WRN("dfu init err %d", ret_val);
	}

    return ret_val;
}

void uart_rx_cb(uint8_t *data, uint16_t len)
{
	// if (bt_nus_send(NULL,data, len)) {
	// 	LOG_WRN("Failed to send data over BLE connection");
	// }	
}
static void error(void)
{
	dk_set_leds_state(DK_ALL_LEDS_MSK, DK_NO_LEDS_MSK);

	while (true) {
		/* Spin for ever */
		k_sleep(K_MSEC(1000));
	}
}

void main(void)
{
	int blink_status = 0;
	int err = 0;

	LOG_INF("### nRF5 SDK DFU example %s %s\n", __TIME__, __DATE__);

	configure_gpio();

	err = uart_init(uart_rx_cb);
	if (err) {
		error();
	}

	err = dfu_init();
	if (err) {
		LOG_ERR("dfu service init err %d", err);
		return;
	}

	for (;;) {
		dk_set_led(RUN_STATUS_LED, (++blink_status) % 2);		
		uart_receive();
	}
}
```

## src/main_resetNetcore.c
```c
/*
 * Copyright (c) 2018 Nordic Semiconductor ASA
 *
 * SPDX-License-Identifier: LicenseRef-Nordic-5-Clause
 */

/** @file
 *  @brief Nordic UART Bridge Service (NUS) sample
 */

#include <zephyr/types.h>
#include <zephyr.h>
#include <drivers/uart.h>

#include <device.h>
#include <soc.h>

#include <dk_buttons_and_leds.h>

#include <settings/settings.h>

#include <stdio.h>

#include "nrf_dfu_settings.h"
#include "nrf_dfu.h"
#include "nrf_rpc.h"
#include "uart_hs.h"
#include "power/reboot.h"
#include "nrf_dfu.h"
#include "nrf_dfu_validation.h"
#include <drivers/nrfx_errors.h>
#include <logging/log.h>
#include <logging/log_ctrl.h>

#define LOG_MODULE_NAME main
LOG_MODULE_REGISTER(LOG_MODULE_NAME);

#define RUN_STATUS_LED DK_LED1
#define RUN_LED_BLINK_INTERVAL 1000


#define UART_BUF_SIZE CONFIG_BT_NUS_UART_BUFFER_SIZE
#define UART_WAIT_FOR_BUF_DELAY K_MSEC(50)
#define UART_WAIT_FOR_RX CONFIG_BT_NUS_UART_RX_WAIT_TIME

static void configure_gpio(void)
{
	int err;

	err = dk_leds_init();
	if (err) {
		LOG_ERR("Cannot init LEDs (err: %d)", err);
	}
}

/**@brief Function for handling DFU events.
 */
static void dfu_observer(nrf_dfu_evt_type_t evt_type)
{
    switch (evt_type)
    {
        case NRF_DFU_EVT_DFU_STARTED:
        case NRF_DFU_EVT_OBJECT_RECEIVED:

            break;
        case NRF_DFU_EVT_DFU_COMPLETED:
        case NRF_DFU_EVT_DFU_ABORTED:
			LOG_INF("resetting...");
			while(log_process(false));
            sys_reboot(SYS_REBOOT_WARM);
            break;
        case NRF_DFU_EVT_TRANSPORT_DEACTIVATED:
            // Reset the internal state of the DFU settings to the last stored state.
			LOG_INF("NRF_DFU_EVT_TRANSPORT_DEACTIVATED");
            nrf_dfu_settings_reinit();
            break;
        default:
            break;
    }

}

int dfu_init(void)
{
    int ret_val;

    ret_val = nrf_dfu_settings_init(true);
    if (ret_val != NRF_SUCCESS)
	{
		LOG_WRN("dfu settings init err %d", ret_val);
	}

    ret_val = nrf_dfu_init(dfu_observer);
    if (ret_val != NRF_SUCCESS)
	{
		LOG_WRN("dfu init err %d", ret_val);
	}

    return ret_val;
}

void uart_rx_cb(uint8_t *data, uint16_t len)
{
	// if (bt_nus_send(NULL,data, len)) {
	// 	LOG_WRN("Failed to send data over BLE connection");
	// }	
}
static void error(void)
{
	dk_set_leds_state(DK_ALL_LEDS_MSK, DK_NO_LEDS_MSK);

	while (true) {
		/* Spin for ever */
		k_sleep(K_MSEC(1000));
	}
}


void main(void)
{
	int blink_status = 0;
	int err = 0;

	printk("### nRF5 SDK DFU example %s %s\n", __TIME__, __DATE__);

	configure_gpio();

	err = uart_init(uart_rx_cb);
	if (err) {
		error();
	}

	err = dfu_init();
	if (err) {
		LOG_ERR("dfu service init err %d", err);
		return;
	}
	k_sleep(K_SECONDS(10));
	printk("turning off netcore\n");
	NRF_RESET->NETWORK.FORCEOFF = RESET_NETWORK_FORCEOFF_FORCEOFF_Hold;
	k_sleep(K_SECONDS(6));
	printk("turning on netcore\n");
	NRF_RESET->NETWORK.FORCEOFF = RESET_NETWORK_FORCEOFF_FORCEOFF_Release;
	k_sleep(K_SECONDS(6));
	err = nrf_rpc_init(NULL);
	printk("rpc init err %d\n", err);
	for (;;) {
		dk_set_led(RUN_STATUS_LED, (++blink_status) % 2);		
		uart_receive();		
	}
}
```
