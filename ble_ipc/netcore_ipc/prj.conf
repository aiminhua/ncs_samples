## CMakeLists.txt
```
#
# Copyright (c) 2018 Nordic Semiconductor
#
# SPDX-License-Identifier: LicenseRef-BSD-5-Clause-Nordic
#
cmake_minimum_required(VERSION 3.13.1)


find_package(Zephyr REQUIRED HINTS $ENV{ZEPHYR_BASE})
project(NONE)

# NORDIC SDK APP START
target_sources(app PRIVATE
  src/main.c
)

target_sources(app PRIVATE
  src/ipc_net_api.c src/ipc_lib.c)

target_sources_ifdef(CONFIG_IPC_SMP_BT app
                     PRIVATE src/ipc_net_smp_bt.c)
					 
# NORDIC SDK APP END

zephyr_library_include_directories(.)
```

## Kconfig
```
#
# Copyright (c) 2018 Nordic Semiconductor
#
# SPDX-License-Identifier: LicenseRef-Nordic-5-Clause
#

source "Kconfig.zephyr"

menu "Nordic UART BLE GATT service sample"

config BT_NUS_THREAD_STACK_SIZE
	int "Thread stack size"
	default 1024
	help
	  Stack size used in each of the two threads

config BT_NUS_UART_BUFFER_SIZE
	int "UART payload buffer element size"
	default 40
	help
	  Size of the payload buffer in each RX and TX FIFO element

config BT_NUS_SECURITY_ENABLED
	bool "Enable security"
	default y
	select BT_SMP
	help
	  "Enable BLE security for the UART service"

config BT_NUS_UART_DEV
	string "UART device name"
	default "UART_0"
	help
	  Name of the used UART device. The sample uses uart0 by default.
	  The UART device should not be used as logger backend.

config BT_NUS_UART_RX_WAIT_TIME
	int "Timeout for UART RX complete event"
	default 50
	help
	  Wait for RX complete event time in milliseconds

config BT_NUS_UART_ASYNC_ADAPTER
	bool "Enable UART async adapter"
	select SERIAL_SUPPORT_ASYNC
	help
	  Enables asynchronous adapter for UART drives that supports only
	  IRQ interface.

config IPC_SMP_BT
	bool "load DFU example over BLE SMP"
	help
		if yes, load DFU example over BLE SMP	  

endmenu
```

## sample.yaml
```
sample:
  name: BLE UART service
  description: Bluetooth Low Energy UART service sample
tests:
  samples.bluetooth.peripheral_uart:
    build_only: true
    build_on_all: true
    platform_allow: nrf5340dk_nrf5340_cpunet
    tags: bluetooth ci_build
```

## prj.conf
```kconfig
#
# Copyright (c) 2018 Nordic Semiconductor
#
# SPDX-License-Identifier: LicenseRef-BSD-5-Clause-Nordic
#

## Open the config if you want to debug netcore ##
# CONFIG_NULL_POINTER_EXCEPTION_DETECTION_NONE=y

# Config logger
CONFIG_LOG=y
CONFIG_USE_SEGGER_RTT=y
CONFIG_LOG_BACKEND_RTT=y
CONFIG_RTT_CONSOLE=y
CONFIG_SERIAL=n
CONFIG_UART_CONSOLE=n
CONFIG_LOG_PRINTK=y

CONFIG_ASSERT=y
# CONFIG_LOG_BUFFER_SIZE=4096

# ## disable logging ##
# CONFIG_LOG=n
# CONFIG_USE_SEGGER_RTT=n
# CONFIG_SERIAL=n
# CONFIG_ASSERT=n
# CONFIG_PRINTK=n

# CONFIG_PRINTK=y
# CONFIG_SERIAL=y
# CONFIG_USE_SEGGER_RTT=y
# CONFIG_RTT_CONSOLE=y

# CONFIG_HEAP_MEM_POOL_SIZE=4096
# CONFIG_SYSTEM_WORKQUEUE_STACK_SIZE=4096

## BT configurations ##
CONFIG_BT=y
CONFIG_BT_PERIPHERAL=y
CONFIG_BT_DEVICE_NAME="comprehensive_ipc"
#limited by RPMSG_BUFFER_SIZE
CONFIG_BT_L2CAP_TX_MTU=492
CONFIG_BT_BUF_ACL_RX_SIZE=502
CONFIG_BT_BUF_ACL_TX_SIZE=502
CONFIG_BT_CTLR_DATA_LENGTH_MAX=251
CONFIG_BT_PERIPHERAL_PREF_MIN_INT=6
CONFIG_BT_PERIPHERAL_PREF_MAX_INT=9
CONFIG_BT_GATT_DYNAMIC_DB=y
CONFIG_BT_RX_STACK_SIZE=4096
# CONFIG_BT_GATT_CLIENT=y
CONFIG_BT_MAX_CONN=8
CONFIG_BT_MAX_PAIRED=5

# Enable the NUS service
CONFIG_BT_NUS=y

## Enable bonding ##
CONFIG_BT_NUS_SECURITY_ENABLED=y
CONFIG_BT_SETTINGS=y
CONFIG_FLASH=y
CONFIG_FLASH_PAGE_LAYOUT=y
CONFIG_FLASH_MAP=y
CONFIG_NVS=y
CONFIG_BT_L2CAP_DYNAMIC_CHANNEL=y
# CONFIG_BT_SETTINGS_CCC_STORE_ON_WRITE=y
# # CONFIG_BT_USE_DEBUG_KEYS=y
# # CONFIG_BT_STORE_DEBUG_KEYS=y
# # CONFIG_SETTINGS_NVS_SECTOR_COUNT=2
CONFIG_PM_PARTITION_SIZE_SETTINGS_STORAGE=0x2000
CONFIG_SETTINGS=y
# CONFIG_BT_SMP_ALLOW_UNAUTH_OVERWRITE=y
CONFIG_BT_LL_SW_SPLIT=y

CONFIG_NRFX_IPC=y
CONFIG_MBOX=n
CONFIG_MBOX_NRFX_IPC=n
CONFIG_NRF53_SYNC_RTC=n
CONFIG_IPC_SMP_BT=y

# CONFIG_SECURE_BOOT=y
# CONFIG_B0_BUILD_STRATEGY_FROM_SOURCE=y
```

## src/main.c
```c
/*
 * Copyright (c) 2018 Nordic Semiconductor ASA
 *
 * SPDX-License-Identifier: LicenseRef-BSD-5-Clause-Nordic
 */

/** @file
 *  @brief Nordic UART Bridge Service (NUS) sample
 */

#include <zephyr/types.h>
#include <zephyr/kernel.h>
#include <zephyr/device.h>
#include <soc.h>
#include <zephyr/bluetooth/bluetooth.h>
#include <zephyr/bluetooth/uuid.h>
#include <zephyr/bluetooth/gatt.h>
#include <zephyr/bluetooth/hci.h>
#include <bluetooth/services/nus.h>
#include <zephyr/settings/settings.h>
#include <stdio.h>
#include <zephyr/logging/log.h>
#include <zephyr/drivers/gpio.h>
#ifdef CONFIG_IPC_SMP_BT
#include "ipc_net_smp_bt.h"
#endif
#include "ipc_net_api.h"
#include "ipc_lib.h"

#define LOG_MODULE_NAME main
LOG_MODULE_REGISTER(LOG_MODULE_NAME);

#define STACKSIZE CONFIG_BT_NUS_THREAD_STACK_SIZE
#define PRIORITY 7

#define DEVICE_NAME CONFIG_BT_DEVICE_NAME
#define DEVICE_NAME_LEN	(sizeof(DEVICE_NAME) - 1)

#define KEY_PASSKEY_ACCEPT DK_BTN1_MSK
#define KEY_PASSKEY_REJECT DK_BTN2_MSK


static K_SEM_DEFINE(ble_conn_ok, 0, 1);

struct bt_conn *current_conn;
// static struct bt_conn *auth_conn;

static const struct bt_data ad[] = {
	BT_DATA_BYTES(BT_DATA_FLAGS, (BT_LE_AD_GENERAL | BT_LE_AD_NO_BREDR)),
	BT_DATA(BT_DATA_NAME_COMPLETE, DEVICE_NAME, DEVICE_NAME_LEN),
};

/*
static const struct bt_data sd[] = {
	BT_DATA_BYTES(BT_DATA_UUID128_ALL, BT_UUID_NUS_VAL),
};
*/


K_SEM_DEFINE(sem_nus_op, 0, 1);

const struct device *gpio_dev;
#define EXT_INT_IO	9  //p0.09
#define EXT_INT_CONF	(GPIO_INPUT | GPIO_PULL_UP)
static struct gpio_callback ext_int_cb_data;

#ifdef CONFIG_BT_GATT_CLIENT
static struct bt_gatt_exchange_params exchange_params;

static void exchange_func(struct bt_conn *conn, uint8_t att_err,
			  struct bt_gatt_exchange_params *params)
{
	if (att_err)
	{
		LOG_ERR("MTU exchange failed");
	}
	else
	{
		LOG_INF("MTU updated to %d", bt_gatt_get_mtu(conn));		
	}
	
}
#endif

static void connected(struct bt_conn *conn, uint8_t err)
{
	char addr[BT_ADDR_LE_STR_LEN];	

	if (err) {
		LOG_ERR("Connection failed (err %u)", err);
		return;
	}

	bt_addr_le_to_str(bt_conn_get_dst(conn), addr, sizeof(addr));
	LOG_INF("Connected %s", (addr));

	current_conn = bt_conn_ref(conn);

	k_sem_give(&ble_conn_ok);

#ifdef CONFIG_BT_NUS_SECURITY_ENABLED
	if (bt_conn_set_security(conn, BT_SECURITY_L2)) {
		LOG_INF("Failed to set security");
	}	
#endif

	err = net2app_send_conn_status(1);
	if (err) {
		LOG_ERR("send connected err %d", err);
	}	

#ifdef CONFIG_BT_GATT_CLIENT		
	exchange_params.func = exchange_func;
	err = bt_gatt_exchange_mtu(conn, &exchange_params);
	if (err) {
		LOG_ERR("MTU exchange failed");
	} 		
#endif
	
}

static void disconnected(struct bt_conn *conn, uint8_t reason)
{
	char addr[BT_ADDR_LE_STR_LEN];

	bt_addr_le_to_str(bt_conn_get_dst(conn), addr, sizeof(addr));

	LOG_INF("Disconnected: %s (reason %u)", (addr), reason);

	if (current_conn) {
		bt_conn_unref(current_conn);
		current_conn = NULL;		
	}

	int err = net2app_send_conn_status(0);
	if (err) {
		LOG_ERR("send disconnected err %d", err);
	}	

}

static void bt_nus_receive_cb(struct bt_conn *conn, const uint8_t *const data,
			  uint16_t len)
{	
	char addr[BT_ADDR_LE_STR_LEN] = {0};
	int err;	

	bt_addr_le_to_str(bt_conn_get_dst(conn), addr, ARRAY_SIZE(addr));

	LOG_INF("Received data from: %s", (addr));
	LOG_HEXDUMP_INF(data, len, "data:");

	err = net2app_send_nus((uint8_t *)data, len);
	if (err) {
		LOG_ERR("network to application core nus send err %d", err);
	}	

}

static struct bt_nus_cb nus_cb = {
	.received = bt_nus_receive_cb,
};

void ext_int_isr(const struct device *dev, struct gpio_callback *cb,
		    uint32_t pins)
{
	LOG_INF("button4 pressed and going to send nus packet\n");
    k_sem_give(&sem_nus_op);    
}

void setup_ext_int(void)
{
	int err;

	gpio_dev = device_get_binding(DT_NODE_FULL_NAME(DT_NODELABEL(gpio0)));
	if (gpio_dev == NULL) {
		printk("GPIO_0 bind error");
		return;
	}
	err = gpio_pin_configure(gpio_dev, EXT_INT_IO,
				EXT_INT_CONF);
	if (err) {
		printk("GPIO_0 config error: %d", err);
		return;
	}

	err = gpio_pin_interrupt_configure(gpio_dev, EXT_INT_IO,
					   GPIO_INT_EDGE_FALLING);
	if (err) {
		printk("GPIO_0 enable callback error: %d", err);
	}

	gpio_init_callback(&ext_int_cb_data, ext_int_isr,
			BIT(EXT_INT_IO));
	err = gpio_add_callback(gpio_dev, &ext_int_cb_data);
	if (err) {
		printk("GPIO_0 add callback error: %d", err);
		return;
	}
}

static int send_to_app(void)
{	
	int ret;
	static uint8_t cnt;
	char test_str[20];

	test_str[0] = 0x1;
	snprintf(&test_str[1], 16, "I am from NET %c", cnt++);
	ret = net2app_test(test_str, 16);
	if (ret)
	{
		LOG_ERR("ipc test error %d", ret);
	}
	else
	{
		LOG_DBG("ipc test done %x", cnt-1);
	}

	return ret;	
}


#ifdef CONFIG_BT_NUS_SECURITY_ENABLED
static void security_changed(struct bt_conn *conn, bt_security_t level,
			     enum bt_security_err err)
{
	char addr[BT_ADDR_LE_STR_LEN];

	bt_addr_le_to_str(bt_conn_get_dst(conn), addr, sizeof(addr));

	if (!err) {
		LOG_INF("Security changed: %s level %u", (addr),
			level);
	} else {
		LOG_WRN("Security failed: %s level %u err %d", (addr),
			level, err);
	}
}
#endif

BT_CONN_CB_DEFINE(conn_callbacks) = {
	.connected    = connected,
	.disconnected = disconnected,
#ifdef CONFIG_BT_NUS_SECURITY_ENABLED
	.security_changed = security_changed,
#endif
};

#if defined(CONFIG_BT_NUS_SECURITY_ENABLED)
// static void auth_passkey_display(struct bt_conn *conn, unsigned int passkey)
// {
// 	char addr[BT_ADDR_LE_STR_LEN];

// 	bt_addr_le_to_str(bt_conn_get_dst(conn), addr, sizeof(addr));

// 	LOG_INF("Passkey for %s: %06u", (addr), passkey);
// }

// static void auth_passkey_confirm(struct bt_conn *conn, unsigned int passkey)
// {
// 	char addr[BT_ADDR_LE_STR_LEN];

// 	auth_conn = bt_conn_ref(conn);

// 	bt_addr_le_to_str(bt_conn_get_dst(conn), addr, sizeof(addr));

// 	LOG_INF("Passkey for %s: %06u", (addr), passkey);
// 	LOG_INF("Press Button 1 to confirm, Button 2 to reject.");
// }


static void auth_cancel(struct bt_conn *conn)
{
	char addr[BT_ADDR_LE_STR_LEN];

	bt_addr_le_to_str(bt_conn_get_dst(conn), addr, sizeof(addr));

	LOG_INF("Pairing cancelled: %s", (addr));
}


static void pairing_complete(struct bt_conn *conn, bool bonded)
{
	char addr[BT_ADDR_LE_STR_LEN];

	bt_addr_le_to_str(bt_conn_get_dst(conn), addr, sizeof(addr));

	LOG_INF("Pairing completed: %s, bonded: %d", (addr),
		bonded);
}


static void pairing_failed(struct bt_conn *conn, enum bt_security_err reason)
{
	char addr[BT_ADDR_LE_STR_LEN];

	bt_addr_le_to_str(bt_conn_get_dst(conn), addr, sizeof(addr));

	LOG_INF("Pairing failed conn: %s, reason %d", (addr),
		reason);
}


static struct bt_conn_auth_cb conn_auth_callbacks = {
	.passkey_display = NULL, //auth_passkey_display,
	.passkey_confirm = NULL, //auth_passkey_confirm,
	.cancel = auth_cancel,
};

static struct bt_conn_auth_info_cb conn_auth_info_callbacks = {
	.pairing_complete = pairing_complete,
	.pairing_failed = pairing_failed
};

// static void num_comp_reply(bool accept)
// {
// 	if (accept) {
// 		bt_conn_auth_passkey_confirm(auth_conn);
// 		LOG_INF("Numeric Match, conn %p", (void *)auth_conn);
// 	} else {
// 		bt_conn_auth_cancel(auth_conn);
// 		LOG_INF("Numeric Reject, conn %p", (void *)auth_conn);
// 	}

// 	bt_conn_unref(auth_conn);
// 	auth_conn = NULL;
// }

// void button_changed(uint32_t button_state, uint32_t has_changed)
// {
// 	uint32_t buttons = button_state & has_changed;

// 	if (auth_conn) {
// 		if (buttons & KEY_PASSKEY_ACCEPT) {
// 			num_comp_reply(true);
// 		}

// 		if (buttons & KEY_PASSKEY_REJECT) {
// 			num_comp_reply(false);
// 		}
// 	}
// }

#else
static struct bt_conn_auth_cb conn_auth_callbacks;
#endif

void main(void)
{
	
	int err = 0;
	
	LOG_INF("### netcore firmware compiled at %s %s", __TIME__, __DATE__);
	
	setup_ext_int();

	if (IS_ENABLED(CONFIG_BT_NUS_SECURITY_ENABLED)) {
		err = bt_conn_auth_cb_register(&conn_auth_callbacks);
		if (err) {
			printk("Failed to register authorization callbacks.\n");
			return;
		}

		err = bt_conn_auth_info_cb_register(&conn_auth_info_callbacks);
		if (err) {
			printk("Failed to register authorization info callbacks.\n");
			return;
		}
	}

	err = bt_enable(NULL);
	if (err) {
		LOG_INF("bt enable error %d", err);		
		return;
	}
	
#ifdef CONFIG_IPC_SMP_BT
	/* Initialize the Bluetooth mcumgr transport. */
	smp_bt_register_ipc();
#endif

	LOG_INF("Bluetooth initialized");	

	if (IS_ENABLED(CONFIG_SETTINGS)) {
		settings_load();
	}

	err = bt_nus_init(&nus_cb);
	if (err) {
		LOG_ERR("Failed to initialize UART service (err: %d)", err);
		return;
	}

	err = bt_le_adv_start(BT_LE_ADV_CONN, ad, ARRAY_SIZE(ad), NULL,
			      0);
	if (err) {
		LOG_ERR("Advertising failed to start (err %d)", err);
	}

	LOG_INF("Started NUS example on netcore");

	for (;;) {		
		k_sleep(K_SECONDS(5));
		LOG_INF("netcore main");
		send_to_app();	
	}
}

void ble_write_thread(void)
{
	static char data[20];
	static uint8_t cnt;
	int err;

	/* Don't go any further until BLE is initialized */
	k_sem_take(&ble_conn_ok, K_FOREVER);
	cnt = 0;

	for (;;) {
		k_sem_take(&sem_nus_op, K_FOREVER);		
		snprintf(data, 12, "HelloNet%d", cnt++);		
		data[11] = 0;		
		err = bt_nus_send(NULL, data, 12);
		if (err) {
			LOG_WRN("bt_nus_send err %d", err);
		}
			
	}
}

K_THREAD_DEFINE(ble_write_thread_id, STACKSIZE, ble_write_thread, NULL, NULL,
		NULL, PRIORITY, 0, 0);
```

## src/ipc_cmd_ids.h
```c
/*
 * Copyright (c) 2020 Nordic Semiconductor ASA
 *
 * SPDX-License-Identifier: Apache-2.0
 */

#ifndef IPC_CMD_IDS_H_
#define IPC_CMD_IDS_H_

#include <zephyr/types.h>


/**
 * @file
 * @defgroup entropy_ser Entropy driver serialization
 * @{
 * @brief Entropy serialization API.
 */

#ifdef __cplusplus
extern "C" {
#endif

#define NET2APP_TEST 1
#define NET2APP_BT_ADDR_SEND 2
#define NET2APP_BT_CONN_STATUS 3
#define NET2APP_BT_NUS_RECV 4
#define NET2APP_BT_SMP_SEND 5
#define NET2APP_BT_SEND_MTU 6

#define APP2NET_TEST 0x81
#define APP2NET_SMP_GET_MTU 0x82
#define APP2NET_SMP_SEND 0x83

#ifdef __cplusplus
}
#endif

/**
 * @}
 */

#endif /* IPC_CMD_IDS_H_ */
```

## src/ipc_lib.c
```c
/*
 * Copyright (c) 2019 Nordic Semiconductor ASA
 *
 * SPDX-License-Identifier: Apache-2.0
 */

#include <zephyr/kernel.h>
#include <nrfx_ipc.h>
#include <stdio.h>
#include <zephyr/logging/log.h>
#include "ipc_lib.h"
#ifdef PM__SRAM_PRIMARY_END_ADDRESS
#include "pm_config.h"
#endif

LOG_MODULE_REGISTER(ipc_lib);

#ifdef PM__SRAM_PRIMARY_END_ADDRESS
#define SHARE_RAM_END_ADDR PM__SRAM_PRIMARY_END_ADDRESS
#else
#define SHARE_RAM_END_ADDR 0x2007e000
#endif
#define IPC_DATA_MAX_SIZE 0x1000/2  ////4kB RAM should be enough
#define SHARE_RAM_BASE_ADDR (SHARE_RAM_END_ADDR - IPC_DATA_MAX_SIZE * 2 )

#ifdef CONFIG_IPC_SMP_BT
#define MAGIC_REQUEST 0x20220408
#define MAGIC_RESPONSE 0x20220616   
#define CH_NO_SEND 1
#define CH_NO_RECEIVE 0
#define IPC_DATA_HEADER_LEN 16
#define IPC_RESPONSE_TIMEOUT 100

typedef struct
{
	uint32_t requst; 
	uint32_t response;      
    uint32_t len; 
    uint8_t * data;             
} nrfx_ipc_data_t;

nrfx_ipc_data_t * ipc_tx_buf = (nrfx_ipc_data_t *) (SHARE_RAM_BASE_ADDR+IPC_DATA_MAX_SIZE);
nrfx_ipc_data_t * ipc_rx_buf = (nrfx_ipc_data_t *) SHARE_RAM_BASE_ADDR;
static ipc_rx_callback_t ipc_rx_callback;
K_SEM_DEFINE(sem_ipc_respone, 0, 1);

static void nrfx_ipc_handler(uint8_t event_mask, void *p_context)
{
	if (event_mask == CH_NO_RECEIVE) {

		if (ipc_rx_buf->response == MAGIC_RESPONSE)
		{
			LOG_DBG("ipc isr response %x", ipc_tx_buf->data[0]);
			ipc_rx_buf->response = 0;
			k_sem_give(&sem_ipc_respone);
		}
		else if (ipc_rx_buf->requst == MAGIC_REQUEST)
		{
			LOG_DBG("ipc isr requst %x", ipc_rx_buf->data[0]);
			if (ipc_rx_callback)
			{
				ipc_rx_callback(ipc_rx_buf->data, ipc_rx_buf->len);
			}
			ipc_tx_buf->response = MAGIC_RESPONSE;
			nrfx_ipc_signal(CH_NO_SEND);	
		}
		else
		{
			LOG_WRN("invalid ipc data");
		}
	}
}

int nrfx_ipc_send(const uint8_t *data, uint16_t size)
{
	int ret;
	
	LOG_DBG("ipc send %x", data[0]);
	if (size > (IPC_DATA_MAX_SIZE - IPC_DATA_HEADER_LEN) )
	{
		return -EINVAL;
	}
	if (ipc_tx_buf->requst == MAGIC_REQUEST)
	{
		LOG_ERR("ipc is busy");
		return -EBUSY;
	}
	ipc_tx_buf->requst = MAGIC_REQUEST;
	ipc_tx_buf->len = size;
	memcpy(ipc_tx_buf->data, data, size);
	nrfx_ipc_signal(CH_NO_SEND);
	ret = k_sem_take(&sem_ipc_respone, K_MSEC(IPC_RESPONSE_TIMEOUT));
	if (ret)
	{
		return -EBUSY;
	}
	ipc_tx_buf->requst = 0;	
	return 0;
}

int init_ipc(ipc_rx_callback_t cb)
{
	int ret;

	ret = nrfx_ipc_init(0, nrfx_ipc_handler, NULL);
	if (ret != NRFX_SUCCESS)
	{
		LOG_ERR("ipc init err %x", ret);
		return -EIO;
	}
	ipc_rx_callback = cb;
	IRQ_CONNECT(NRFX_IRQ_NUMBER_GET(NRF_IPC), 4,
		    nrfx_isr, nrfx_ipc_irq_handler, 0);
	ipc_tx_buf->data = (void *)((uint32_t) ipc_tx_buf + IPC_DATA_HEADER_LEN);
	ipc_rx_buf->data = (void *)((uint32_t) ipc_rx_buf + IPC_DATA_HEADER_LEN);
	ipc_tx_buf->requst = 0;
	ipc_tx_buf->response = 0;
	ipc_rx_buf->requst = 0;
	ipc_rx_buf->response = 0;		

	nrf_ipc_send_config_set(NRF_IPC, CH_NO_SEND, 1 << CH_NO_SEND);
	nrf_ipc_receive_config_set(NRF_IPC, CH_NO_RECEIVE, 1 << CH_NO_RECEIVE);
	nrf_ipc_int_enable(NRF_IPC, 1 << CH_NO_RECEIVE);

	return 0;	
}

#else
#define MAGIC_VALID 0x20220408  
#define CH_NO_SEND 1
#define CH_NO_RECEIVE 0
#define IPC_DATA_HEADER_LEN 16

typedef struct
{
    uint32_t valid;
	uint32_t busy;     
    uint32_t len; 
    uint8_t * data;             
} nrfx_ipc_data_t;

nrfx_ipc_data_t * ipc_tx_buf = (nrfx_ipc_data_t *) (SHARE_RAM_BASE_ADDR+IPC_DATA_MAX_SIZE);
nrfx_ipc_data_t * ipc_rx_buf = (nrfx_ipc_data_t *) SHARE_RAM_BASE_ADDR;
static ipc_rx_callback_t ipc_rx_callback;

static void nrfx_ipc_handler(uint32_t event_mask, void *p_context)
{
	LOG_DBG("event_mask %d", event_mask);
	if (event_mask == (1 << CH_NO_RECEIVE)) {
		// we just print out the data
		if (ipc_rx_buf->valid != MAGIC_VALID)
		{
			LOG_WRN("invalid ipc data %x", ipc_rx_buf->valid);			
		}
		else
		{
			// LOG_HEXDUMP_INF(ipc_rx_buf->data, ipc_rx_buf->len, "Received: ");
			/* after processe is done, you must reset the buffer to prepare for next receive. 
			 otherwise, you cannot get the next receive */
			if (ipc_rx_callback)
			{
				ipc_rx_callback(ipc_rx_buf->data, ipc_rx_buf->len);
			}
			ipc_rx_buf->valid = 0;
			ipc_rx_buf->busy = 0;
		}
	}
}

int nrfx_ipc_send(const uint8_t *data, uint16_t size)
{
	if (size > (IPC_DATA_MAX_SIZE - IPC_DATA_HEADER_LEN) )
	{
		return -EINVAL;
	}
	if (ipc_tx_buf->valid == MAGIC_VALID && ipc_tx_buf->busy == 1)
	{
		LOG_ERR("##ipc is busy");
		ipc_tx_buf->busy = 0; //temp use only
		return -EBUSY;
	}
	ipc_tx_buf->valid = MAGIC_VALID;
	ipc_tx_buf->busy = 1;
	ipc_tx_buf->len = size;
	memcpy(ipc_tx_buf->data, data, size);
	nrfx_ipc_signal(CH_NO_SEND);
	return 0;
}

int init_ipc(ipc_rx_callback_t cb)
{
	int ret;

	ret = nrfx_ipc_init(0, nrfx_ipc_handler, NULL);
	if (ret != NRFX_SUCCESS)
	{
		LOG_ERR("ipc init err %x", ret);
		return ret;
	}
	ipc_rx_callback = cb;
	IRQ_CONNECT(NRFX_IRQ_NUMBER_GET(NRF_IPC), 4,
		    nrfx_isr, nrfx_ipc_irq_handler, 0);
	ipc_tx_buf->data = (void *)((uint32_t) ipc_tx_buf + IPC_DATA_HEADER_LEN);
	ipc_rx_buf->data = (void *)((uint32_t) ipc_rx_buf + IPC_DATA_HEADER_LEN);
	ipc_tx_buf->valid = 0;
	ipc_tx_buf->busy = 0;
	ipc_rx_buf->valid = 0;
	ipc_rx_buf->busy = 0;	

	nrf_ipc_send_config_set(NRF_IPC, CH_NO_SEND, 1 << CH_NO_SEND);
	nrf_ipc_receive_config_set(NRF_IPC, CH_NO_RECEIVE, 1 << CH_NO_RECEIVE);
	nrf_ipc_int_enable(NRF_IPC, 1 << CH_NO_RECEIVE);

	return 0;	
}
#endif
```

## src/ipc_net_api.c
```c
/*
 * Copyright (c) 2020 Nordic Semiconductor ASA
 *
 * SPDX-License-Identifier: LicenseRef-BSD-5-Clause-Nordic
 */

#include <zephyr/kernel.h>
#include <zephyr/device.h>
#include <zephyr/devicetree.h>
#include <zephyr/drivers/gpio.h>
#include <stdio.h>
#include <zephyr/logging/log.h>
#include <zephyr/bluetooth/bluetooth.h>
#include <zephyr/bluetooth/gatt.h>
#include <zephyr/bluetooth/hci.h>
#include "ipc_lib.h"
#include "../../ipc_cmd_ids.h"
#include "ipc_net_api.h"
#include "ipc_net_smp_bt.h"

#define LOG_MODULE_NAME ipc_api
LOG_MODULE_REGISTER(LOG_MODULE_NAME);

struct ipc_data_t {	
	uint8_t *data;
	uint16_t len;
};
static struct ipc_data_t ipc_temp;
extern struct bt_conn *current_conn;
static K_SEM_DEFINE(sem_ipc_rx, 0, 1);

static void ipc_rx_handler(uint8_t *data, uint16_t len)
{
	switch (data[0])
	{
#ifdef CONFIG_IPC_SMP_BT		
		case APP2NET_SMP_GET_MTU:
			net2app_send_bt_mtu();
		break;

		case APP2NET_SMP_SEND:
			ipc_net_bt_smp_send(current_conn, &data[1], len-1);			
		break;
#endif
		case APP2NET_TEST:
			LOG_HEXDUMP_INF(&data[1], len-1, "IPC test:");
		break;		

		default:
			LOG_ERR("undefined IPC request");
		break;
	}	
}

static void ipc_net_rx_cb(uint8_t *data, uint16_t len)
{
	ipc_temp.len = len;
	ipc_temp.data = data;
	k_sem_give(&sem_ipc_rx);
}

int net2app_send_bt_addr(void)
{

	bt_addr_le_t addrs[CONFIG_BT_ID_MAX];
	size_t count = ARRAY_SIZE(addrs);
	char addr_s[BT_ADDR_LE_STR_LEN];
	char data[8];
	int ret;

	bt_id_get(addrs, &count);
	bt_addr_le_to_str(&addrs[0], addr_s, sizeof(addr_s));
	printk("===BT dev addr: %s ====\n", addr_s);

	data[0] = NET2APP_BT_ADDR_SEND;
	memcpy(&data[1], (uint8_t *)&addrs[0], 7);

	ret = nrfx_ipc_send(data, sizeof(data));
	if (ret) {
		LOG_ERR("BT dev addr sent err %d", ret);
	}	
	return ret;
	 
}

int net2app_send_nus(uint8_t *data, uint16_t len)
{
	uint8_t buf[CONFIG_BT_L2CAP_TX_MTU+1];

	buf[0] = NET2APP_BT_NUS_RECV;
	memcpy(&buf[1], data, len);

	return nrfx_ipc_send(buf, len+1);	
}

int net2app_send_conn_status(uint8_t connected)
{
	uint8_t data[2];

	data[0] = NET2APP_BT_CONN_STATUS;
	data[1] = connected;

	return nrfx_ipc_send(data, sizeof(data));	
}

#ifdef CONFIG_IPC_SMP_BT
int net2app_send_bt_mtu(void)
{
	uint8_t data[3];
	uint16_t mtu = bt_gatt_get_mtu(current_conn) - 3;
	LOG_DBG("smp BT MTU:%d", mtu);	

	data[0] = NET2APP_BT_SEND_MTU;
	*((uint16_t *) &data[1]) = mtu;

	return nrfx_ipc_send(data, sizeof(data));	
}

int net2app_bt_smp_send(uint8_t *data, uint16_t len)
{
	uint8_t buf[CONFIG_BT_L2CAP_TX_MTU+1];
	LOG_HEXDUMP_DBG(data, len, "smp cmd:");
	buf[0] = NET2APP_BT_SMP_SEND;
	memcpy(&buf[1], data, len);

	return nrfx_ipc_send(buf, len+1);	
}
#endif

int net2app_test(uint8_t *data, uint16_t len)
{
	uint8_t buf[250];

	if (len > 249) len = 249;

	buf[0] = NET2APP_TEST;
	memcpy(&buf[1], data, len);

	return nrfx_ipc_send(buf, len+1);	
}

void ipc_thread(void)
{

	LOG_INF("Dual core communication by nrfx_ipc API");

	init_ipc(ipc_net_rx_cb);
	k_sleep(K_SECONDS(3)); //wait for BT stack init
	net2app_send_bt_addr();

	while (1) {
		k_sem_take(&sem_ipc_rx, K_FOREVER);
		ipc_rx_handler(ipc_temp.data, ipc_temp.len);
	}

}

K_THREAD_DEFINE(ipc_thread_id, 1024, ipc_thread, NULL, NULL,
		NULL, 6, 0, 0);
```

## src/ipc_net_api.h
```c
/*
 * Copyright (c) 2020 Nordic Semiconductor ASA
 *
 * SPDX-License-Identifier: Apache-2.0
 */

#ifndef IPC_NET_API_H_
#define IPC_NET_API_H_

#include <zephyr/types.h>


/**
 * @file
 * @defgroup entropy_ser Entropy driver serialization
 * @{
 * @brief Entropy serialization API.
 */

#ifdef __cplusplus
extern "C" {
#endif

int net2app_send_bt_addr(void);
int net2app_send_nus(uint8_t *data, uint16_t len);
int net2app_send_conn_status(uint8_t connected);
int net2app_send_bt_mtu(void);
int net2app_bt_smp_send(uint8_t *data, uint16_t len);
int net2app_test(uint8_t *data, uint16_t len);

#ifdef __cplusplus
}
#endif

/**
 * @}
 */

#endif /* IPC_NET_API_H_ */
```

## src/ipc_net_smp_bt.c
```c
/*
 * Copyright (c) 2020 Nordic Semiconductor ASA
 *
 * SPDX-License-Identifier: LicenseRef-BSD-5-Clause-Nordic
 */

/** @file
 * @brief Bluetooth transport for the mcumgr SMP protocol.
 */

#include <errno.h>

#include <zephyr/kernel.h>
#include <zephyr/init.h>
#include <zephyr/bluetooth/bluetooth.h>
#include <zephyr/bluetooth/uuid.h>
#include <zephyr/bluetooth/gatt.h>
#include <zephyr/logging/log.h>
#include "ipc_net_api.h"

LOG_MODULE_REGISTER(ipc_smp_bt, 3);

/* SMP service.
 * {8D53DC1D-1DB7-4CD3-868B-8A527460AA84}
 */
static struct bt_uuid_128 smp_bt_svc_uuid = BT_UUID_INIT_128(
	0x84, 0xaa, 0x60, 0x74, 0x52, 0x8a, 0x8b, 0x86,
	0xd3, 0x4c, 0xb7, 0x1d, 0x1d, 0xdc, 0x53, 0x8d);

/* SMP characteristic; used for both requests and responses.
 * {DA2E7828-FBCE-4E01-AE9E-261174997C48}
 */
static struct bt_uuid_128 smp_bt_chr_uuid = BT_UUID_INIT_128(
	0x48, 0x7c, 0x99, 0x74, 0x11, 0x26, 0x9e, 0xae,
	0x01, 0x4e, 0xce, 0xfb, 0x28, 0x78, 0x2e, 0xda);

/**
 * Write handler for the SMP characteristic; processes an incoming SMP request.
 */
static ssize_t smp_bt_chr_write(struct bt_conn *conn,
				const struct bt_gatt_attr *attr,
				const void *buf, uint16_t len, uint16_t offset,
				uint8_t flags)
{
	LOG_HEXDUMP_DBG(buf, len, "smp bt rx:");
	net2app_bt_smp_send((uint8_t *)buf, len);
	return len;
}

static void smp_bt_ccc_changed(const struct bt_gatt_attr *attr, uint16_t value)
{
	net2app_send_bt_mtu();
}

static struct bt_gatt_attr smp_bt_attrs[] = {
	/* SMP Primary Service Declaration */
	BT_GATT_PRIMARY_SERVICE(&smp_bt_svc_uuid),

	BT_GATT_CHARACTERISTIC(&smp_bt_chr_uuid.uuid,
			       BT_GATT_CHRC_WRITE_WITHOUT_RESP |
			       BT_GATT_CHRC_NOTIFY,
#ifdef CONFIG_MCUMGR_SMP_BT_AUTHEN
			       BT_GATT_PERM_WRITE_AUTHEN,
#else
			       BT_GATT_PERM_WRITE,
#endif
			       NULL, smp_bt_chr_write, NULL),
	BT_GATT_CCC(smp_bt_ccc_changed,
#ifdef CONFIG_MCUMGR_SMP_BT_AUTHEN
			       BT_GATT_PERM_READ_AUTHEN |
			       BT_GATT_PERM_WRITE_AUTHEN),
#else
			       BT_GATT_PERM_READ | BT_GATT_PERM_WRITE),
#endif
};

static struct bt_gatt_service smp_bt_svc = BT_GATT_SERVICE(smp_bt_attrs);

/**
 * Transmits an SMP response over the specified Bluetooth connection.
 */
void ipc_net_bt_smp_send(struct bt_conn *conn, void *data, uint16_t len)
{	
	LOG_HEXDUMP_DBG(data, len, "bt notify: ");
	bt_gatt_notify(conn, smp_bt_attrs + 2, data, len);	
}

int smp_bt_register_ipc(void)
{
	printk("register smp bt\r");
	return bt_gatt_service_register(&smp_bt_svc);
}

int smp_bt_unregister_ipc(void)
{
	return bt_gatt_service_unregister(&smp_bt_svc);
}
```

## src/ipc_net_smp_bt.h
```c
/*
 * Copyright (c) 2020 Nordic Semiconductor ASA
 *
 * SPDX-License-Identifier: Apache-2.0
 */

#ifndef RPC_NET_SMP_BT_H_
#define RPC_NET_SMP_BT_H_

#include <zephyr/types.h>
#include <zephyr/bluetooth/bluetooth.h>

/**
 * @file
 * @defgroup entropy_ser Entropy driver serialization
 * @{
 * @brief Entropy serialization API.
 */

#ifdef __cplusplus
extern "C" {
#endif

int smp_bt_register_ipc(void);

int smp_bt_unregister_ipc(void);

void ipc_net_bt_smp_send(struct bt_conn *conn, void *data, uint16_t len);

#ifdef __cplusplus
}
#endif

/**
 * @}
 */

#endif /* RPC_NET_SMP_BT_H_ */
```
