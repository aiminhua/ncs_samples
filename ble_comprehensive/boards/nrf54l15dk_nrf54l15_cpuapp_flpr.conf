## ble_comprehensive/boards/nrf54l15dk_nrf54l15_cpuapp_flpr.conf
```kconfig
CONFIG_NORDIC_QSPI_NOR=n
CONFIG_SPI=y
CONFIG_SPI_NOR=y
CONFIG_SPI_NOR_FLASH_LAYOUT_PAGE_SIZE=4096
CONFIG_NRF_RRAM_WRITE_BUFFER_SIZE=32

CONFIG_ZMS=y
# Set the ZMS sector count to match the settings partition size that is 40 kB for this application.
CONFIG_SETTINGS_ZMS_SECTOR_COUNT=11
# Workaround required as Zephyr L2 implies usage of NVS backend for settings.
# It should be removed once the proper fix will be applied in Zephyr.
CONFIG_NVS=n

CONFIG_EXAMPLE_FLASH_NVS=n

CONFIG_SERIAL=y
CONFIG_NRFX_UARTE30=y
CONFIG_NRFX_UARTE20=n
CONFIG_PM_PARTITION_SIZE_SETTINGS_STORAGE=0x2000
```

## ble_comprehensive/boards/nrf7002dk_nrf5340_cpuapp.conf
```kconfig
# External SPI flash (no QSPI on nRF7002DK)
CONFIG_NORDIC_QSPI_NOR=n
CONFIG_SPI=y
CONFIG_SPI_NOR=y
CONFIG_SPI_NOR_FLASH_LAYOUT_PAGE_SIZE=4096

# UART1 high-speed async (1 Mbps)
CONFIG_UART_0_ASYNC=n
CONFIG_UART_1_ASYNC=y
CONFIG_UART_1_NRF_HW_ASYNC=y
CONFIG_UART_1_NRF_HW_ASYNC_TIMER=1

## NVS flash storage backend
CONFIG_SAMPLE_FLASH_NVS=y
CONFIG_NVS=y
```

## ble_comprehensive/sysbuild/mcuboot/boards/nrf5340dk_nrf5340_cpuapp.conf
```kconfig
#
# Copyright (c) 2021 Nordic Semiconductor
#
# SPDX-License-Identifier: LicenseRef-Nordic-5-Clause
#

CONFIG_BOARD_ENABLE_DCDC_APP=n
CONFIG_BOARD_ENABLE_DCDC_NET=n
CONFIG_BOARD_ENABLE_DCDC_HV=n

CONFIG_CLOCK_CONTROL_NRF_K32SRC_RC=y
CONFIG_CLOCK_CONTROL_NRF_K32SRC_XTAL=n
CONFIG_CLOCK_CONTROL_NRF_K32SRC_RC_CALIBRATION=n

CONFIG_BOOT_MAX_IMG_SECTORS=224

## the following kconfig are optional
# CONFIG_DEBUG_OPTIMIZATIONS=y

# Disable memory guard to avoid false faults in application after boot
CONFIG_HW_STACK_PROTECTION=n

CONFIG_SYSTEM_CLOCK_NO_WAIT=y

CONFIG_MAIN_STACK_SIZE=10240

CONFIG_BOOT_BOOTSTRAP=n

CONFIG_BOOT_SIGNATURE_TYPE_ECDSA_P256=y
## replace the default signing key with your own key before production ##
# CONFIG_BOOT_SIGNATURE_KEY_FILE="mcuboot_private.pem"

## the following kconfig is used to make external flash as the secondary slot
CONFIG_FLASH=y
CONFIG_BOOT_ERASE_PROGRESSIVELY=y
# CONFIG_FPROTECT=y

# Required by QSPI
CONFIG_MULTITHREADING=y

CONFIG_NORDIC_QSPI_NOR=y
CONFIG_NORDIC_QSPI_NOR_FLASH_LAYOUT_PAGE_SIZE=4096
CONFIG_NORDIC_QSPI_NOR_STACK_WRITE_BUFFER_SIZE=16

CONFIG_SOC_FLASH_NRF_EMULATE_ONE_BYTE_WRITE_ACCESS=y
CONFIG_FLASH_SIMULATOR=y
CONFIG_FLASH_SIMULATOR_UNALIGNED_READ=y
CONFIG_FLASH_SIMULATOR_DOUBLE_WRITES=y
CONFIG_PM_EXTERNAL_FLASH_MCUBOOT_SECONDARY=y
CONFIG_FLASH_SIMULATOR_STATS=n
```

## ble_comprehensive/sysbuild/mcuboot/boards/nrf54l15dk_nrf54l15_cpuapp.conf
```kconfig
# #
# # Copyright (c) 2024 Nordic Semiconductor ASA
# #
# # SPDX-License-Identifier: LicenseRef-Nordic-5-Clause
# #


# # nRF54L15DK uses SPI NOR external flash
# CONFIG_GPIO=y
# CONFIG_SPI=y
# CONFIG_SPI_NOR=y
# CONFIG_SPI_NOR_SFDP_DEVICETREE=y
# CONFIG_SPI_NOR_FLASH_LAYOUT_PAGE_SIZE=4096

# # required by SPI driver
# CONFIG_MULTITHREADING=y
# # Adjust the maximum sectors to the app image size of ~1.4MB
CONFIG_BOOT_MAX_IMG_SECTORS=512
```

## ble_ipc/comprehensiv_ipc/Kconfig
```kconfig
#
# Copyright (c) 2018 Nordic Semiconductor ASA
#
# SPDX-License-Identifier: LicenseRef-BSD-5-Clause-Nordic
#

source "Kconfig.zephyr"
menu "comprehensive_ipc example"

config BLE_NETWORK_CORE
	bool "Both BLE host and controller run on network core"
	help
	  Enable the whole BLE stack running on network core

config EXAMPLE_I2C
	bool "load I2C example or not"
	help
		if yes, load I2C example
		
config EXAMPLE_SPIM
	bool "load SPI master example or not"
	help
		if yes, load SPI master example		
		
config EXAMPLE_EXT_INT
	bool "load external IO interrupt example or not"
	help
		if yes, load external IO interrupt example

config EXAMPLE_ADC
	bool "load ADC example or not"
	help
		if yes, load ADC example		

config EXAMPLE_HS_UART
	bool "load high speed UART example or not"
	help
		if yes, load high speed UART example	  

config EXAMPLE_FLASH
	bool "load Flash access usage example"
	default n
	help
		if yes, load Flash access usage example

config IPC_CUSTOM
	bool "Custom IPC is used for the dual core communication"
	help
	  Custom IPC is used for the dual core communication
	  
config IPC_SMP_BT
	bool "load DFU example over BLE SMP"
	help
		if yes, load DFU example over BLE SMP

config IPC_REASSEMBLY_BT
	bool "enable reassembly of BT packets"
	select MCUMGR_SMP_REASSEMBLY
	help
		if yes, enable reassembly of BT packets
		
module = COMPREHENSIVE_IPC_EXAMPLE_CONFIG
module-str = comprehensive_ipc example configurations
source "${ZEPHYR_BASE}/subsys/logging/Kconfig.template.log_config"

endmenu
```

## ble_ipc/comprehensiv_ipc/sample.yaml
```yaml
sample:
  name: Comprehensive rpc example
  description: secondary slot on external QSPI flash. Both BT host and controller run on network core.
tests:
  samples.bluetooth.peripheral_uart:
    build_only: true
    build_on_all: true
    platform_allow: nrf5340dk_nrf5340_cpuapp nrf5340dk_nrf5340_cpuappns
    tags: bluetooth ci_build
```

## comprehensive_rpc/sdk_change/ncs_v1.5.x/nrf/subsys/nrf_dfu/Kconfig
```kconfig
# USB configuration options

# Copyright (c) 2016 Wind River Systems, Inc.
# SPDX-License-Identifier: Apache-2.0

menu "nRF DFU module"

menuconfig NRF_DFU
	bool "DFU module ported from nRF5 SDK"
	help
	  "Enable Nordic DFU module"

config NRF_DFU_BT
	bool "Enable BLE transport"	
	help
	  "Transfer the new image by BLE transport"
	  
config NRF_DFU_RPC_APP
	bool "transform BLE transport to RPC API on app core side"	
	help
	  "Can only be used on appcore. Transform BLE transport to RPC API on app core side"

config NRF_DFU_RPC_NET
	bool "transform BLE transport to RPC API on net core side"	
	help
	  "Can only be used on netcore. Transform BLE transport to RPC API on net core side"

config NRF_DFU_LOG_LEVEL
	int "Set the log level of nrf_dfu module"
	default 2	
	help
	  Set the log level of nrf_dfu module

module = NRF_DFU
module-str = NRF_DFU
source "${ZEPHYR_BASE}/subsys/logging/Kconfig.template.log_config"
	  
endmenu
```

## nrf_dfu/ble_intFlash_nrf5_bl/sdk_change/ncs_v1.5.x/nrf/subsys/nrf_dfu/Kconfig
```kconfig
# USB configuration options

# Copyright (c) 2016 Wind River Systems, Inc.
# SPDX-License-Identifier: Apache-2.0

menu "nRF DFU module"

menuconfig NRF_DFU
	bool "DFU module ported from nRF5 SDK"
	help
	  "Enable Nordic DFU module"

config NRF_DFU_BT
	bool "Enable BLE transport"
    select NRF_DFU_PROTOCOL_REDUCED  	
	help
	  "Transfer the new image by BLE transport"

config NRF_DFU_UART
	bool "Enable UART transport"	
	help
	  "Transfer the new image by UART interface"	  

config NRF_DFU_PROTOCOL_REDUCED
	bool "Reduced DFU protocol set"
	help
	  "Reduced DFU protocol set"
	  
config NRF_DFU_RPC_APP
	bool "transform BLE transport to RPC API on app core side"	
	help
	  "Can only be used on appcore. Transform BLE transport to RPC API on app core side"

config NRF_DFU_RPC_NET
	bool "transform BLE transport to RPC API on net core side"	
	help
	  "Can only be used on netcore. Transform BLE transport to RPC API on net core side"

config NRF_DFU_LOG_LEVEL
	int "Set the log level of nrf_dfu module"
	default 3	
	help
	  Set the log level of nrf_dfu module

config NRF_DFU_THREAD_STACK_SIZE
	int "Set the stack size of DFU thread"
	default 1536	
	help
	  Set the stack size of DFU thread

config NRF_DFU_THREAD_PRIO
	int "Set the priority of DFU thread"
	default 8	
	help
	  Set the priority of DFU thread

config NRF_DFU_BLE_MIN_CONN_INTERVAL
	int "Set the minimum BLE connection interval during DFU process"
	default 8	
	help
	  Set the minimum BLE connection interval during DFU process

config NRF_DFU_BLE_MAX_CONN_INTERVAL
	int "Set the maximum BLE connection interval during DFU process"
	default 15	
	help
	  Set the maximum BLE connection interval during DFU process

config NRF_DFU_BLE_CONN_SUP_TIMEOUT
	int "Set connection supervisory timeout during DFU process"
	default 400	
	help
	  Set connection supervisory timeout during DFU process

config NRF_DFU_UART_DEV_NAME
	string
	default "UART_0"

config NRF_DFU_UART_BUF_SIZE
	int "Set the size of the nrf_dfu UART buffer"
	default 192	
	help
	  Set the size of the nrf_dfu UART buffer	

module = NRF_DFU
module-str = NRF_DFU
source "${ZEPHYR_BASE}/subsys/logging/Kconfig.template.log_config"
	  
endmenu
```

## nrf_dfu/ble_intFlash_nrf5_bl/sdk_change/ncs_v1.7.x/nrf/subsys/nrf_dfu/Kconfig
```kconfig
# USB configuration options

# Copyright (c) 2016 Wind River Systems, Inc.
# SPDX-License-Identifier: Apache-2.0

menu "nRF DFU module"

menuconfig NRF_DFU
	bool "DFU module ported from nRF5 SDK"
	help
	  "Enable Nordic DFU module"

config NRF_DFU_BT
	bool "Enable BLE transport"	
	help
	  "Transfer the new image by BLE transport"
	  
config NRF_DFU_RPC_APP
	bool "transform BLE transport to RPC API on app core side"	
	help
	  "Can only be used on appcore. Transform BLE transport to RPC API on app core side"

config NRF_DFU_RPC_NET
	bool "transform BLE transport to RPC API on net core side"	
	help
	  "Can only be used on netcore. Transform BLE transport to RPC API on net core side"

config NRF_DFU_LOG_LEVEL
	int "Set the log level of nrf_dfu module"
	default 2	
	help
	  Set the log level of nrf_dfu module

config NRF_DFU_THREAD_STACK_SIZE
	int "Set the stack size of DFU thread"
	default 1536	
	help
	  Set the stack size of DFU thread

config NRF_DFU_THREAD_PRIO
	int "Set the priority of DFU thread"
	default 8	
	help
	  Set the priority of DFU thread	  

module = NRF_DFU
module-str = NRF_DFU
source "${ZEPHYR_BASE}/subsys/logging/Kconfig.template.log_config"
	  
endmenu
```

## smp_dfu/peripheral_uart_1s_intFlash/sample.yaml
```yaml
sample:
  description: Peripheral UART + BLE SMP
  name: Peripheral UART + BLE SMP
tests:
  sample.bluetooth.peripheral_uart:
    build_only: true
    platform_allow: nrf5340dk_nrf5340_cpuapp nrf52840dk_nrf52840
    tags: bluetooth ci_build
```

## smp_dfu/peripheral_uart_2s_intFlash_mock/sample.yaml
```yaml
sample:
  description: Peripheral UART + BLE SMP
  name: Peripheral UART + BLE SMP
tests:
  sample.bluetooth.peripheral_uart:
    build_only: true
    platform_allow: nrf5340dk_nrf5340_cpuapp
    tags: bluetooth ci_build
```
